## firmware/esp32/main/Kconfig.projbuild
```kconfig
menu "StatusCast ESP32"

    config SC_HTTP_PORT
        int "HTTP port for /status/ and /health"
        default 5099

    config SC_ENABLE_DISPLAY
        bool "Enable the SSD1315 128x64 OLED"
        default y

    config SC_I2C_SDA_GPIO
        int "SSD1315 I2C SDA GPIO"
        default 8

    config SC_I2C_SCL_GPIO
        int "SSD1315 I2C SCL GPIO"
        default 9

    config SC_OLED_I2C_ADDR
        hex "SSD1315 I2C address"
        default 0x3C
        help
            Most 0.96" 128x64 modules answer at 0x3C; a few use 0x3D.
            The driver probes this address first and falls back to the other.

    config SC_OLED_CAROUSEL_SECONDS
        int "Seconds per display page"
        default 5

    config SC_CONSOLE_UART_NUM
        int "UART number for the serial console commands"
        default 0

    config SC_PC_FEED_DEFAULT_ENABLED
        bool "Enable the PC daemon bridge when config.json has no PcFeed block"
        default n

    config SC_CONTROL_TOKEN
        string "Shared token for the /control/ endpoints"
        default "statuscast"
        help
            Windows calls POST /control/... with this value in the
            X-StatusCast-Token header. Change it (Kconfig or POST
            /control/token) before exposing the board outside a trusted LAN.

    config SC_MAX_SNAPSHOT_JSON
        int "Snapshot JSON buffer size in bytes"
        default 8192

endmenu
```
